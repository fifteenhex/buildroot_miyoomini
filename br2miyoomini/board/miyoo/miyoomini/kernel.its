## br2miyoomini/board/miyoo/miyoomini/kernel.its
```
/dts-v1/;

/ {
	description = "Miyoo Mini";
	#address-cells = <1>;

	images {
		kernel-0 {
			/*
			 * genimage copies this .its into $(BUILD_DIR)/genimage.tmp
			 * before invoking mkimage, and dtc resolves /incbin/ paths
			 * relative to the .its file's own directory. From
			 * output/build/genimage.tmp that means ../../images.
			 */
			data = /incbin/("../../images/zImage");
			type = "kernel";
			arch = "arm";
			os = "linux";
			compression = "none";
			load = <0x22800000>;
			entry = <0x22800000>;
			hash-1 {
				algo = "crc32";
			};
			hash-2 {
				algo = "sha1";
			};
		};
		fdt-0 {
			data = /incbin/("../../images/mstar-infinity2m-ssd202d-miyoo-mini.dtb");
			type = "flat_dt";
			arch = "arm";
			compression = "none";
			load = <0x24000000>;
			hash-1 {
				algo = "crc32";
			};
			hash-2 {
				algo = "sha1";
			};
		};
	};

	configurations {
		default = "conf-0";
		conf-0 {
			kernel = "kernel-0";
			fdt = "fdt-0";
		};
	};
};
```

## br2miyoomini/configs/miyoomini_defconfig
```kconfig
BR2_arm=y
BR2_cortex_a7=y
BR2_ARM_FPU_NEON_VFPV4=y
# BR2_PIC_PIE is not set
BR2_RELRO_NONE=y
BR2_FORTIFY_SOURCE_NONE=y
BR2_TOOLCHAIN_BUILDROOT_GLIBC=y
BR2_TOOLCHAIN_BUILDROOT_CXX=y
BR2_GCC_ENABLE_LTO=y
BR2_TARGET_GENERIC_HOSTNAME="miyoomini"
BR2_TARGET_GENERIC_ISSUE="Welcome to MiyooMini"
# BR2_TARGET_GENERIC_REMOUNT_ROOTFS_RW is not set
BR2_ROOTFS_USERS_TABLES="$(BR2_EXTERNAL_MIYOOMINI_PATH)/users"
BR2_ROOTFS_OVERLAY="$(BR2_EXTERNAL_MIYOOMINI_PATH)/board/miyoo/miyoomini/overlay/"
BR2_PACKAGE_STRACE=y
BR2_PACKAGE_VALGRIND=y
# BR2_PACKAGE_VALGRIND_CACHEGRIND is not set
# BR2_PACKAGE_VALGRIND_CALLGRIND is not set
# BR2_PACKAGE_VALGRIND_HELGRIND is not set
# BR2_PACKAGE_VALGRIND_DRD is not set
# BR2_PACKAGE_VALGRIND_MASSIF is not set
# BR2_PACKAGE_VALGRIND_DHAT is not set
BR2_PACKAGE_EXFATPROGS=y
BR2_PACKAGE_MTD=y
# BR2_PACKAGE_MTD_FLASHCP is not set
# BR2_PACKAGE_MTD_FLASH_LOCK is not set
# BR2_PACKAGE_MTD_FLASH_UNLOCK is not set
# BR2_PACKAGE_MTD_NANDDUMP is not set
# BR2_PACKAGE_MTD_NANDTEST is not set
# BR2_PACKAGE_MTD_NANDWRITE is not set
# BR2_PACKAGE_MTD_MTDINFO is not set
# BR2_PACKAGE_MTD_UBIATTACH is not set
# BR2_PACKAGE_MTD_UBICRC32 is not set
# BR2_PACKAGE_MTD_UBIDETACH is not set
# BR2_PACKAGE_MTD_UBIFORMAT is not set
# BR2_PACKAGE_MTD_UBIHEALTHD is not set
# BR2_PACKAGE_MTD_UBIMKVOL is not set
# BR2_PACKAGE_MTD_UBINFO is not set
# BR2_PACKAGE_MTD_UBINIZE is not set
# BR2_PACKAGE_MTD_UBIRENAME is not set
# BR2_PACKAGE_MTD_UBIRMVOL is not set
# BR2_PACKAGE_MTD_UBIRSVOL is not set
# BR2_PACKAGE_MTD_UBIUPDATEVOL is not set
# BR2_PACKAGE_MTD_UBIBLOCK is not set
BR2_PACKAGE_CHOCOLATE_DOOM=y
BR2_PACKAGE_SDL2=y
BR2_PACKAGE_SDL2_DIRECTFB2=y
BR2_PACKAGE_ALSA_LIB=y
# BR2_PACKAGE_ALSA_LIB_OLD_SYMBOLS is not set
BR2_PACKAGE_OPENAL=y
BR2_PACKAGE_ZLIB_NG=y
BR2_PACKAGE_LIBEVENT=y
# BR2_PACKAGE_IFUPDOWN_SCRIPTS is not set
# BR2_PACKAGE_URANDOM_SCRIPTS is not set
BR2_TARGET_ROOTFS_EROFS=y
BR2_PACKAGE_HOST_CMAKE=y
BR2_PACKAGE_HOST_DOSFSTOOLS=y
BR2_PACKAGE_HOST_MTOOLS=y
BR2_MIYOOMINI=y
BR2_PACKAGE_SANETIME=y
BR2_PACKAGE_BOCHS=y
BR2_PACKAGE_MEDNAFEN=y
BR2_PACKAGE_SCUMMVM=y
BR2_PACKAGE_SCUMMVM_ENGINE_SCUMMV7V8=y
BR2_PACKAGE_LVSHELL=y
BR2_PACKAGE_DIRECTFB2=y
BR2_PACKAGE_DIRECTFB2_MULTI=y
BR2_PACKAGE_DIRECTFB2_DRMKMS=y
```
